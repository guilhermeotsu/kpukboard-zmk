#include "zmk-helpers/unicode-chars/portuguese.dtsi"

/*                KEY POSITIONS

  ╭───────────────────╮ ╭───────────────────╮
  │ 0   1  2  3  4  5 │ │ 6   7  8  9 10 11 │
  │ 12 13 14 15 16 17 │ │ 18 19 20 21 22 23 │
  │    24 25 26 27 28 │ │ 29 30 31 32 33    │
  ╰────────────╮34 35 │ │ 36 37 ╭───────────╯
               ╰──────╯ ╰───────╯                 */



#define COMBO_TERM_FAST 15
#define COMBO_TERM_SLOW 30

// ZMK_COMBO(lpar, &kp LPAR, 19 20, DEF, COMBO_TERM_FAST, COMBO_TERM_FAST)
// ZMK_COMBO(rpar, &kp RPAR, 20 21, DEF, COMBO_TERM_FAST, COMBO_TERM_FAST)
// ZMK_COMBO(lbra, &kp LBRC, 7   8, DEF, COMBO_TERM_FAST, COMBO_TERM_FAST)
// ZMK_COMBO(rbra, &kp RBRC, 8   9, DEF, COMBO_TERM_FAST, COMBO_TERM_FAST)
// ZMK_COMBO(lbkt, &kp LBKT, 30 31, DEF, COMBO_TERM_FAST, COMBO_TERM_FAST)
// ZMK_COMBO(rbkt, &kp RBKT, 31 32, DEF, COMBO_TERM_FAST, COMBO_TERM_FAST)
ZMK_COMBO(bksp, &kp BSPC, 7 8, DEF, 10, 10)
ZMK_COMBO(dlte, &kp DEL, 8 9, DEF, 10, 10)
ZMK_COMBO(esc , &kp ESC, 2 4, DEF, COMBO_TERM_FAST, COMBO_TERM_FAST)
ZMK_COMBO(mclk, &mkp MCLK, 36 37, MOUSE, COMBO_TERM_FAST, COMBO_TERM_FAST)
ZMK_COMBO(bclt, &bt BT_CLR, 0 12, FUN, COMBO_TERM_SLOW, COMBO_TERM_SLOW)

ZMK_COMBO(lalt, &kp LALT, 34 35, LOL, COMBO_TERM_FAST, COMBO_TERM_FAST)
ZMK_COMBO(tlol, &tog LOL, 12 23, LOL DEF, COMBO_TERM_FAST, COMBO_TERM_FAST)
ZMK_COMBO(altb, &swapper, 3 4, LOL, COMBO_TERM_FAST, COMBO_TERM_FAST)
// ZMK_COMBO(copy, &kp K_COPY, 14 15, All, COMBO_TERM_FAST, COMBO_TERM_FAST)
// ZMK_COMBO(pste, &kp K_PASTE, 15 16, All, COMBO_TERM_FAST, COMBO_TERM_FAST)
// ZMK_COMBO(cedl, &pt_c_cedilla, 25 26, DEF, COMBO_TERM_FAST, COMBO_TERM_FAST)
